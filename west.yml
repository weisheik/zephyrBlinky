## west.yml
```yaml
# The west manifest file for upstream Zephyr.
#
# The per-installation west configuration file, .west/config, sets the
# path to the project containing this file in the [manifest] section's
# "path" variable.
#
# You are free to create your own manifest files and put them in any
# repository you want, to create your own custom Zephyr installations.
# For example, you could create a manifest file in your own out of
# tree application directory, which would pull this zephyr repository
# in as an ordinary project.
#
# You can pass your manifest repositories to west init when creating a
# new Zephyr installation. See the west documentation for more
# information.

manifest:
  defaults:
    remote: upstream

  remotes:
    - name: upstream
      url-base: https://github.com/zephyrproject-rtos

  #
  # Please add items below based on alphabetical order
  projects:
    - name: zephyr
      revision: main
      west-commands: scripts/west-commands.yml
    - name: cmsis
      revision: c3bd2094f92d574377f7af2aec147ae181aa5f8e
      path: modules/hal/cmsis
      groups:
        - hal
    - name: edtt
      revision: 7dd56fc100d79cc45c33d43e7401d1803e26f6e7
      path: tools/edtt
      groups:
        - tools
    - name: hal_nordic
      revision: 00fd2aa97a22ea1052d9dabe1b18ab396daab93a
      path: modules/hal/nordic
      groups:
        - hal
    - name: hal_nxp
      revision: 4b493d4346e841e786a8daa2eb2ee03cbe5cfd37
      path: modules/hal/nxp
      groups:
        - hal
    - name: hal_stm32
      revision: 7e5f46d25a292f4a140af6da7afc0efc67d56e45
      path: modules/hal/stm32
      groups:
        - hal
    - name: mcuboot
      revision: 62b78ff2a2148490f91ee9a4b4d7a7ab8bbc4fd4
      path: bootloader/mcuboot
    - name: segger
      revision: 3a52ab222133193802d3c3b4d21730b9b1f1d2f6
      path: modules/debug/segger
      groups:
        - debug
    - name: tinycbor
      revision: 40daca97b478989884bffb5226e9ab73ca54b8c4
      path: modules/lib/tinycbor
    - name: tinycrypt
      revision: 3e9a49d2672ec01435ffbf0d788db6d95ef28de0
      path: modules/crypto/tinycrypt
      groups:
        - crypto

  self:
    path: zephyrBlinky
```
